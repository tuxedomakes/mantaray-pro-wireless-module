## boards/shields/mantaray_pro_wireless/Kconfig.defconfig
```kconfig
if SHIELD_MANTARAY_PRO_WIRELESS_LEFT

config ZMK_KEYBOARD_NAME
    default "Mantaray Pro W"

config ZMK_SPLIT_ROLE_CENTRAL
    default y

endif

if SHIELD_MANTARAY_PRO_WIRELESS_LEFT || SHIELD_MANTARAY_PRO_WIRELESS_RIGHT

config ZMK_SPLIT
    default y

endif
```

## boards/shields/mantaray_pro_wireless/Kconfig.shield
```kconfig
# Copyright (c) 2025 Colton Hawkins
# SPDX-License-Identifier: MIT

config SHIELD_MANTARAY_PRO_WIRELESS_LEFT
    def_bool $(shields_list_contains,mantaray_pro_wireless_left)

config SHIELD_MANTARAY_PRO_WIRELESS_RIGHT
    def_bool $(shields_list_contains,mantaray_pro_wireless_right)
```
